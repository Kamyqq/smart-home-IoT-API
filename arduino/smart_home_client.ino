#include <WiFiS3.h>
#include <DHT.h>

#define DHTPIN 2
#define DHTTYPE DHT11
#define LIGHT_PIN A0

#define LED_PIN 4

DHT dht(DHTPIN, DHTTYPE);

char ssid[] = "xxxxxxxx"; // <= wifi name
char server[] = "192.168.x.x"; // <= local ip
const char* apiKey = "xxxxxxxxx"; // <= laravel device apiKey generated by seeder
int port = 8000;
WiFiClient client;

void setup() {
  Serial.begin(9600);
  delay(3000);

  Serial.print("Connecting to network...");
  WiFi.begin(ssid);

  while (WiFi.status() != WL_CONNECTED) {
    delay(500);
    Serial.print(".");
  }

  Serial.println("\nPassword accepted. Waiting for IP assignment...");

  while (WiFi.localIP() == IPAddress(0, 0, 0, 0)) {
    delay(500);
    Serial.print("*");
  }

  Serial.println("\nConnected!");
  Serial.println(WiFi.localIP());
  dht.begin();
  pinMode(LED_PIN, OUTPUT);
}

void loop() {
  delay(30000);

  float humidity = dht.readHumidity();
  float temperature = dht.readTemperature();
  int lightLevel = analogRead(LIGHT_PIN);

  if (isnan(humidity) || isnan(temperature)) {
    Serial.println("Failed to read from DHT sensor!");
    return;
  }

  Serial.print("Humidity: ");
  Serial.println(humidity);

  Serial.print("Temperature: ");
  Serial.println(temperature);

  Serial.print("Light Level: ");
  Serial.println(lightLevel);

  String jsonBody = "{\"temperature\": " + String(temperature) + ", \"humidity\": " + String(humidity) + ", \"light\": " + String(lightLevel) + "}";

  bool isConnected = false;
  int attempts = 0;

  while (!isConnected && attempts < 4) {
    if (client.connect(server, port)) {
      isConnected = true;
    } else {
      attempts++;
      Serial.print("Server ignoring request. Retrying... (Attempt ");
      Serial.print(attempts);
      Serial.println(")");
      client.stop();
      delay(1000);
    }
  }

  if (isConnected) {
    Serial.println("Connected to server, sending POST request...");

    client.println("POST /api/measurements HTTP/1.1");
    client.print("Host: ");
    client.println(server);
    client.println("Content-Type: application/json");
    client.print("X-API-KEY: ");
    client.println(apiKey);
    client.println("Connection: close");
    client.print("Content-Length: ");
    client.println(jsonBody.length());
    client.println();
    client.println(jsonBody);

    unsigned long timeout = millis();
    while (client.available() == 0) {
      if (millis() - timeout > 5000) {
        Serial.println("No response from server (Timeout)");
        client.stop();
        return;
      }
    }

    Serial.println("Server response:");
    while (client.available()) {
      char c = client.read();
      Serial.print(c);
    }

    client.stop();
    Serial.println("\nDisconnected from server.");

  } else {
    Serial.println("CRITICAL ERROR. Traffic fully blocked (check firewall).");
  }

  Serial.println("Fetching commands from server (GET)...");

  if (client.connect(server, port)) {
    client.println("GET /api/room-actions HTTP/1.1");
    client.print("Host: ");
    client.println(server);
    client.print("X-API-KEY: ");
    client.println(apiKey);
    client.println("Connection: close");
    client.println();

    String response = "";
    unsigned long timeout = millis();

    while (client.available() == 0) {
      if (millis() - timeout > 5000) {
        Serial.println("No response to GET request (Timeout)");
        client.stop();
        return;
      }
    }

    while (client.available()) {
      char c = client.read();
      response += c;
    }

    client.stop();

    Serial.println("===================");
    Serial.println(response);
    Serial.println("===================");

    if (response.indexOf("\"turn_on_light\":1") != -1 || response.indexOf("\"turn_on_light\": 1") != -1) {
      digitalWrite(LED_PIN, HIGH);
      Serial.println("Server command: TURN ON LIGHT");
    } else {
      digitalWrite(LED_PIN, LOW);
      Serial.println("Server command: TURN OFF LIGHT");
    }
  } else {
    Serial.println("Failed to connect to server for GET request.");
  }
}
